## config/west.yml
```yaml
manifest:
  remotes:
  - name: zmkfirmware
    url-base: https://github.com/zmkfirmware
  - name: gpeye
    url-base: https://github.com/GPeye
  - name: tokyo2006
    url-base: https://github.com/tokyo2006
  - name: englmaxi
    url-base: https://github.com/englmaxi
  - name: mctechnology17
    url-base: https://github.com/mctechnology17
    # Additional modules containing boards/shields/custom code can be listed here as well
    # See https://docs.zephyrproject.org/3.2.0/develop/west/manifest.html#projects
  projects:
  - name: zmk
    remote: zmkfirmware
    revision: v0.3
    import: app/west.yml
  - name: cirque-input-module
    url: https://github.com/petejohanson/cirque-input-module
    revision: main
    path: modules/cirque-input-module
  - name: hammerbeam-slideshow
    remote: gpeye
    revision: main 
  - name: prospector-zmk-module                 # <--- and these
    remote: tokyo2006                          # <---
    revision: change_spi2
  - name: zmk-dongle-display
    remote: englmaxi
    revision: main
  - name: zmk-nice-oled
    remote: mctechnology17
    revision: main
  self:
    path: config
```
